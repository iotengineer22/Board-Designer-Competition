## src/board/misoji/test_nrf54l15dk/Kconfig.test_nrf54l15dk
```kconfig
config BOARD_TEST_NRF54L15DK
	select SOC_NRF54L15_CPUAPP if BOARD_TEST_NRF54L15DK_NRF54L15_CPUAPP
	select SOC_NRF54L15_CPUFLPR if \
		BOARD_TEST_NRF54L15DK_NRF54L15_CPUFLPR || \
		BOARD_TEST_NRF54L15DK_NRF54L15_CPUFLPR_XIP
```

## src/board/misoji/test_nrf54l15dk/board.yml
```yaml
board:
  name: test_nrf54l15dk
  vendor: misoji
  socs:
  - name: nrf54l15
    variants:
    - name: xip
      cpucluster: cpuflpr
    # - name: ns
    #   cpucluster: cpuapp
```
